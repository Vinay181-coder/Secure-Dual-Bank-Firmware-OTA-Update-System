# file: Secure_Firmware_Boot.ioc
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Mcu.Family=STM32F4
Mcu.Name=STM32F446R(C-E)Tx
Mcu.Package=LQFP64
NVIC.PriorityGroup=NVIC_PRIORITYGROUP_4
PA13.Mode=Serial_Wire
PA13.Signal=SYS_JTMS-SWDIO
PA14.Mode=Serial_Wire
PA14.Signal=SYS_JTCK-SWCLK
PA5.Signal=GPIO_Output
PH0-OSC_IN.Mode=HSE-External-Oscillator
PH0-OSC_IN.Signal=RCC_OSC_IN
PH1-OSC_OUT.Mode=HSE-External-Oscillator
PH1-OSC_OUT.Signal=RCC_OSC_OUT
ProjectManager.HeapSize=0x200
ProjectManager.StackSize=0x400
ProjectManager.TargetToolchain=STM32CubeIDE
RCC.CortexFreq_Value=16000000
RCC.USBFreq_Value=96000000
RCC.VCOOutputFreq_Value=192000000
board=custom

// file: Core/Src/main.c
/* USER CODE BEGIN Header */
/**
  ******************************************************************************
  * @file           : main.c
  * @brief          : Bootloader
  ******************************************************************************
  */
/* USER CODE END Header */
#include "main.h"

/* USER CODE BEGIN Includes */
#include "metadata.h"
#include <string.h>
/* USER CODE END Includes */

/* USER CODE BEGIN PD */
#define FLASH_SECTOR_METADATA    FLASH_SECTOR_2
/* USER CODE END PD */

void SystemClock_Config(void);
static void MX_GPIO_Init(void);
/* USER CODE BEGIN PFP */
static void     blink(uint32_t n);
static void     jump_to_app(uint32_t app_addr);
static uint32_t compute_crc32(uint32_t addr, uint32_t size);
static void     erase_sector(uint32_t sector);
static void     write_metadata(boot_metadata_t *m);
/* USER CODE END PFP */

/* USER CODE BEGIN 0 */

static void blink(uint32_t n)
{
    for (uint32_t i = 0; i < n; i++)
    {
        HAL_GPIO_WritePin(GPIOA, GPIO_PIN_5, GPIO_PIN_SET);
        HAL_Delay(200);
        HAL_GPIO_WritePin(GPIOA, GPIO_PIN_5, GPIO_PIN_RESET);
        HAL_Delay(200);
    }
    HAL_Delay(600);
}

static void jump_to_app(uint32_t app_addr)
{
    uint32_t app_sp = *(volatile uint32_t *)(app_addr);
    uint32_t app_pc = *(volatile uint32_t *)(app_addr + 4U);

    if (app_sp < 0x20000000UL || app_sp > 0x20020000UL)
        return;

    if (app_pc < 0x08000000UL || app_pc > 0x08080000UL)
        return;

    /* Lock flash */
    HAL_FLASH_Lock();

    /* Disable SysTick */
    SysTick->CTRL = 0U;
    SysTick->LOAD = 0U;
    SysTick->VAL  = 0U;

    /* Clear all NVIC interrupts */
    for (uint8_t i = 0; i < 8; i++)
    {
        NVIC->ICER[i] = 0xFFFFFFFFUL;
        NVIC->ICPR[i] = 0xFFFFFFFFUL;
    }

    /* Disable all interrupts */
   //__disable_irq();

    /* Relocate vector table */
    SCB->VTOR = app_addr;
    __DSB();
    __ISB();

    /* Set stack pointer and jump */
    __set_MSP(app_sp);
    __set_CONTROL(0U);
    __ISB();

   __enable_irq();

    ((void (*)(void))app_pc)();

    while (1);
}

static uint32_t compute_crc32(uint32_t addr, uint32_t size)
{
    __HAL_RCC_CRC_CLK_ENABLE();
    CRC->CR = CRC_CR_RESET;
    uint32_t *src   = (uint32_t *)addr;
    uint32_t  words = size / 4U;
    for (uint32_t i = 0; i < words; i++)
        CRC->DR = src[i];
    uint32_t remaining = size % 4U;
    if (remaining > 0U)
    {
        uint32_t last_word = 0U;
        uint8_t *tail = (uint8_t *)(addr + (words * 4U));
        for (uint32_t i = 0; i < remaining; i++)
            last_word |= ((uint32_t)tail[i] << (i * 8U));
        CRC->DR = last_word;
    }
    return CRC->DR;
}

static void erase_sector(uint32_t sector)
{
    FLASH_EraseInitTypeDef erase_init = {0};
    uint32_t sector_error = 0U;
    erase_init.TypeErase    = FLASH_TYPEERASE_SECTORS;
    erase_init.Sector       = sector;
    erase_init.NbSectors    = 1U;
    erase_init.VoltageRange = FLASH_VOLTAGE_RANGE_3;
    HAL_FLASH_Unlock();
    HAL_FLASHEx_Erase(&erase_init, &sector_error);
    HAL_FLASH_Lock();
}

static void write_metadata(boot_metadata_t *m)
{
    erase_sector(FLASH_SECTOR_METADATA);
    HAL_FLASH_Unlock();
    uint32_t addr = METADATA_BASE;
    uint32_t *src = (uint32_t *)m;
    for (uint32_t i = 0; i < (sizeof(boot_metadata_t) / 4U); i++)
    {
        if (HAL_FLASH_Program(FLASH_TYPEPROGRAM_WORD, addr, src[i]) != HAL_OK)
        {
            HAL_FLASH_Lock();
            Error_Handler();
        }
        addr += 4U;
    }
    HAL_FLASH_Lock();
}

/* USER CODE END 0 */

int main(void)
{

  /* MCU Configuration--------------------------------------------------------*/

  /* Reset of all peripherals, Initializes the Flash interface and the Systick. */
  HAL_Init();

  /* Configure the system clock */
  SystemClock_Config();

  /* Initialize all configured peripherals */
  MX_GPIO_Init();
  /* USER CODE BEGIN 2 */

    blink(1);  /* 1 blink = bootloader started */

    uint32_t boot_flag = METADATA->boot_flag;
    uint32_t crc_exp   = METADATA->fw_crc32;
    uint32_t fw_size   = METADATA->fw_size;
    uint32_t fw_ver    = METADATA->fw_version;

    if (boot_flag == BOOT_FLAG_BANK_B)
    {
        blink(2);  /* 2 blinks = OTA path */

        if (fw_size == 0U || fw_size > BANK_B_MAX_SIZE)
        {
            blink(5);  /* 5 blinks = bad size */
            jump_to_app(BANK_A_ADDR);
        }

        uint32_t crc_actual = compute_crc32(BANK_B_ADDR, fw_size);

        if (crc_actual == crc_exp)
        {
            blink(3);  /* 3 blinks = CRC passed */
            boot_metadata_t new_meta = {0};
            new_meta.boot_flag  = BOOT_FLAG_BANK_A;
            new_meta.fw_version = fw_ver;
            new_meta.fw_crc32   = crc_exp;
            new_meta.fw_size    = fw_size;
            new_meta.fw_bank    = BANK_B_ADDR;
            write_metadata(&new_meta);
            jump_to_app(BANK_B_ADDR);
        }
        else
        {
            blink(4);  /* 4 blinks = CRC failed */
            boot_metadata_t rollback = {0};
            rollback.boot_flag  = BOOT_FLAG_BANK_A;
            rollback.fw_version = fw_ver;
            rollback.fw_crc32   = 0U;
            rollback.fw_size    = 0U;
            rollback.fw_bank    = BANK_A_ADDR;
            write_metadata(&rollback);
            jump_to_app(BANK_A_ADDR);
        }
    }
    else
    {
        blink(1);  /* 1+1 blinks = normal boot path */
        jump_to_app(BANK_A_ADDR);

        /* Jump failed — fast blink */
        while (1)
        {
            HAL_GPIO_TogglePin(GPIOA, GPIO_PIN_5);
            HAL_Delay(200);
        }
    }

}

void SystemClock_Config(void)
{
  RCC_OscInitTypeDef RCC_OscInitStruct = {0};
  RCC_ClkInitTypeDef RCC_ClkInitStruct = {0};

  /** Configure the main internal regulator output voltage
  */
  __HAL_RCC_PWR_CLK_ENABLE();
  __HAL_PWR_VOLTAGESCALING_CONFIG(PWR_REGULATOR_VOLTAGE_SCALE3);

  /** Initializes the RCC Oscillators according to the specified parameters
  * in the RCC_OscInitTypeDef structure.
  */
  RCC_OscInitStruct.OscillatorType = RCC_OSCILLATORTYPE_HSI;
  RCC_OscInitStruct.HSIState = RCC_HSI_ON;
  RCC_OscInitStruct.HSICalibrationValue = RCC_HSICALIBRATION_DEFAULT;
  RCC_OscInitStruct.PLL.PLLState = RCC_PLL_NONE;
  if (HAL_RCC_OscConfig(&RCC_OscInitStruct) != HAL_OK)
  {
    Error_Handler();
  }

  /** Initializes the CPU, AHB and APB buses clocks
  */
  RCC_ClkInitStruct.ClockType = RCC_CLOCKTYPE_HCLK|RCC_CLOCKTYPE_SYSCLK
                              |RCC_CLOCKTYPE_PCLK1|RCC_CLOCKTYPE_PCLK2;
  RCC_ClkInitStruct.SYSCLKSource = RCC_SYSCLKSOURCE_HSI;
  RCC_ClkInitStruct.AHBCLKDivider = RCC_SYSCLK_DIV1;
  RCC_ClkInitStruct.APB1CLKDivider = RCC_HCLK_DIV1;
  RCC_ClkInitStruct.APB2CLKDivider = RCC_HCLK_DIV1;

  if (HAL_RCC_ClockConfig(&RCC_ClkInitStruct, FLASH_LATENCY_0) != HAL_OK)
  {
    Error_Handler();
  }
}

static void MX_GPIO_Init(void)
{
  GPIO_InitTypeDef GPIO_InitStruct = {0};

  /* GPIO Ports Clock Enable */
  __HAL_RCC_GPIOH_CLK_ENABLE();
  __HAL_RCC_GPIOA_CLK_ENABLE();

  /*Configure GPIO pin Output Level */
  HAL_GPIO_WritePin(GPIOA, GPIO_PIN_5, GPIO_PIN_RESET);

  /*Configure GPIO pin : PA5 */
  GPIO_InitStruct.Pin = GPIO_PIN_5;
  GPIO_InitStruct.Mode = GPIO_MODE_OUTPUT_PP;
  GPIO_InitStruct.Pull = GPIO_NOPULL;
  GPIO_InitStruct.Speed = GPIO_SPEED_FREQ_LOW;
  HAL_GPIO_Init(GPIOA, &GPIO_InitStruct);

}

void Error_Handler(void)
{
  __disable_irq();
  while (1)
  {
  }
}
